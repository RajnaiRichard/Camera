#include "Camera.h"
#include "string"
#include "string.h"

int32_t cameraIO_init()
{
	if(hdcmi.State != HAL_DCMI_STATE_READY)
	{
		HAL_DCMI_Init(&hdcmi);

	}
	if(hi2c3.State != HAL_I2C_STATE_READY)
	{
		HAL_I2C_Init(&hi2c3);
	}

	return OV5640_OK;
}

int32_t cameraIO_deinit()
{
	if (hdcmi.State != HAL_DCMI_STATE_BUSY)
	{
		HAL_DCMI_DeInit(&hdcmi);
	}
	if(hi2c3.State != HAL_I2C_STATE_BUSY)
	{
		HAL_I2C_DeInit(&hi2c3);
	}


	return OV5640_OK;
}

int32_t i2c_write(uint16_t deviceAddress, uint16_t address, uint8_t* data, uint16_t Lenght)
{
	uint8_t addressAndData[Lenght+2] = {(uint8_t)((address >> 8) & 0xFF), (uint8_t)(address & 0xFF)};
	std::copy(data,data+Lenght,addressAndData+2);
	HAL_I2C_Master_Transmit(&hi2c3, deviceAddress, addressAndData, sizeof(addressAndData), HAL_MAX_DELAY);

	return OV5640_OK;
}
int32_t i2c_read(uint16_t deviceAddress,uint16_t address, uint8_t* data, uint16_t Lenght)
{
	uint8_t addressArray[] = {(uint8_t)((address >> 8) & 0xFF), (uint8_t)(address & 0xFF)};
	HAL_I2C_Master_Transmit(&hi2c3, deviceAddress, addressArray, sizeof(addressArray), HAL_MAX_DELAY);
	HAL_I2C_Master_Receive(&hi2c3, deviceAddress | 0x0001, data, Lenght, HAL_MAX_DELAY);
	return OV5640_OK;
}

int32_t HAL_GetTick_Wrapper(void) {
	return (int32_t)HAL_GetTick();
}
OV5640_IO_t cameraIO =
{
	.Init = cameraIO_init,
	.DeInit = cameraIO_deinit,
	.Address = 0x78,
	.WriteReg = i2c_write,
	.ReadReg = i2c_read,
	.GetTick = HAL_GetTick_Wrapper
};
OV5640_Object_t cameraObj ={
	.IsInitialized = 0,
	.Mode = PARALLEL_MODE
};

//send a test image to test to communication and display program on PC side
void Send_test_img()
{

	uint16_t rowSize = 160;
	uint16_t rowSizeBytes = 160*2; //one pixel 16 bit
	uint16_t columnSize = 120;
	char header[] = "CAM";
	//int testImgSize = rowSize*comomnSize; //160x120=19200 image
	uint16_t testImg[]={ 44240, 44272, 44303, 46351, 48399, 48399, 46319, 44239, 44240, 42160, 42160, 42160, 33904,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 2310, 198};



	for(int i=0;i<columnSize;i++)
	{
		HAL_UART_Transmit(&huart2, (uint8_t*)header,strlen(header), HAL_MAX_DELAY);
		HAL_UART_Transmit(&huart2, (uint8_t*)&testImg[i*rowSize], rowSizeBytes, HAL_MAX_DELAY);
		HAL_Delay(2);
	}
}
//initialize the camera module
void Camera_init()
{

	Send_test_img();
	OV5640_RegisterBusIO(&cameraObj, &cameraIO);
	uint32_t Id =0;
	OV5640_ReadID(&cameraObj, &Id);
	OV5640_Init(&cameraObj, OV5640_R160x120, OV5640_RGB565);

	std::fill(img, &img[imgSize-1], 0);
	__HAL_DCMI_ENABLE_IT(&hdcmi, DCMI_IT_FRAME);
	HAL_DCMI_Start_DMA(&hdcmi, DCMI_MODE_SNAPSHOT,  (uint32_t)img, imgSize);
}

//when the entire frame is captured send it
void HAL_DCMI_FrameEventCallback(DCMI_HandleTypeDef *hdcmi)
{

	uint16_t rowSize = 160; //in pixels
	uint16_t columnSize = 120; //in pixels
	uint16_t rowSizeBytes = 160*2; //one pixel 16 bit (2 bytes)

	char header[] = "CAM";

	//send one row of picture at a time with a header
	for(int i=0;i<columnSize;i++)
	{
		HAL_UART_Transmit(&huart2, (uint8_t*)header,strlen(header), HAL_MAX_DELAY);
		HAL_UART_Transmit(&huart2, (uint8_t*)&img[i*rowSize/2], rowSizeBytes, HAL_MAX_DELAY);
		HAL_Delay(2);
	}


}

